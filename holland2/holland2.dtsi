// imports

#include "holland2-audio.dtsi"
#include "holland2-camera.dtsi"
#include "holland2-general.dtsi"
#include "holland2-gpu.dtsi"
#include "holland2-mdss.dtsi"
#include "holland2-misc.dtsi"
#include "holland2-misc-ext.dtsi"
#include "holland2-pinctrl.dtsi"
