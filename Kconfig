## Kconfig
```kconfig
#
# For a description of the syntax of this configuration file,
# see Documentation/kbuild/kconfig-language.txt.
#
mainmenu "Linux/$ARCH $KERNELVERSION Kernel Configuration"

config SRCARCH
	string
	option env="SRCARCH"
	
config HQ_ZQL1590_SUPPORT
        bool "HQ_ZQL1590_SUPPORT"
	default n

config HQ_QL1590_NO_OTG
    bool "HQ QL1590 NO OTG"
        default n
source "arch/$SRCARCH/Kconfig"
```

## arch/arm64/hotplug/Kconfig
```kconfig
config MSM_HOTPLUG
	bool "MSM hotplug by [Fluxi]"
	depends on HOTPLUG_CPU
	default n
	help
	  The MSM hotplug driver controls on-/offlining of additional cores based on current cpu load.

config ASMP
	bool "Multi-core automatic hotplug support"
	depends on SMP
	default n
	help
	Automatically hotplugs the multiple cpu cores on and off
	based on cpu load and suspend stat

config INTELLI_PLUG
         bool "Enable intelli-plug cpu hotplug driver"
         default n
         help
           Generic Intelli-plug cpu hotplug driver for ARM SOCs

config LAZYPLUG
	bool "Lazyplug Conservative hotplugging for generic devices"
	default n
	help
	  This enables the conservative hotplugging, lazyplug by arter97
	  based on intelli_plug. Refer to the comments for more info.

config ALUCARD_HOTPLUG
	bool "Alucard hotplug"
 	default n
 	help
 	  Generic Alucard-hotplug cpu hotplug driver for ARM SOCs

config THUNDERPLUG_CONTROL
	bool "Thunderplug plugging down/up of cores based on load per core"
	depends on SMP && HOTPLUG_CPU
	default n
	help
	  This driver hotplugs cpu cores based on per-core load
```

## drivers/android/Kconfig
```kconfig
config ANDROID_SIMPLE_LMK
	bool "Simple Android Low Memory Killer"
	depends on !ANDROID_LOW_MEMORY_KILLER && !MEMCG
	---help---
	  This is a complete low memory killer solution for Android that is
	  small and simple. Processes are killed according to the priorities
	  that Android gives them, so that the least important processes are
	  always killed first. Processes are killed until memory deficits are
	  satisfied, as observed from kswapd struggling to free up pages. Simple
	  LMK stops killing processes when kswapd finally goes back to sleep.

if ANDROID_SIMPLE_LMK

config ANDROID_SIMPLE_LMK_MINFREE
	int "Minimum MiB of memory to free per reclaim"
	range 8 512
	default 128
	help
	  Simple LMK will try to free at least this much memory per reclaim.

config ANDROID_SIMPLE_LMK_TIMEOUT_MSEC
	int "Reclaim timeout in milliseconds"
	range 50 1000
	default 200
	help
	  Simple LMK tries to wait until all of the victims it kills have their
	  memory freed; however, sometimes victims can take a while to die,
	  which can block Simple LMK from killing more processes in time when
	  needed. After the specified timeout elapses, Simple LMK will stop
	  waiting and make itself available to kill more processes.

endif
```

## drivers/clk/msm/mdss/Kconfig
```kconfig
config MSM_MDSS_PLL
	bool "MDSS pll programming"
	---help---
	It provides support for DSI, eDP and HDMI interface pll programming on MDSS
	hardware. It also handles the pll specific resources and turn them on/off when
	mdss pll client tries to enable/disable pll clocks.
	
config  ZQL1520_LCM_SSC
        bool "ZQL1520_LCM_SSC"
	default n

config  ZQL1590_LCM_SSC
        bool "ZQL1590_LCM_SSC"
	default n
```

## drivers/input/fingerprint/Kconfig
```kconfig
#
# fingerprint driver configuration
#
menuconfig INPUT_FINGERPRINT
	bool "fingerprint"
	help
	  Say Y here, and a list of supported touchscreens will be displayed.
	  This option doesn't affect the kernel.

	  If unsure, say Y.

if INPUT_FINGERPRINT

config INPUT_FINGERPRINT_GSL6153_ZQL1520
	tristate "GSL6135_ZQL1520"
	depends on SPI
	help
	  Say Y here if you have a 88PM860x PMIC and want to enable
	  support for the built-in touchscreen.

	  If unsure, say N.

	  To compile this driver as a module, choose M here: the
	  module will be called 88pm860x-ts.
	  
config INPUT_FINGERPRINT_GF3258_ZQL1520
	tristate "GF3258_ZQL1520"
	depends on SPI
	help
	  Say Y here if you have a 88PM860x PMIC and want to enable
	  support for the built-in touchscreen.

	  If unsure, say N.

	  To compile this driver as a module, choose M here: the
	  module will be called 88pm860x-ts.
	  
config INPUT_FINGERPRINT_GF3258_ZQL1590
	tristate "GF3258_ZQL1590"
	depends on SPI
	help
	  Say Y here if you have a 88PM860x PMIC and want to enable
	  support for the built-in touchscreen.

	  If unsure, say N.

	  To compile this driver as a module, choose M here: the
	  module will be called 88pm860x-ts.
	  
config INPUT_FINGERPRINT_GSL6153_ZQL1590
	tristate "GSL6135_ZQL1520"
	depends on SPI
	help
	  Say Y here if you have a 88PM860x PMIC and want to enable
	  support for the built-in touchscreen.

	  If unsure, say N.

	  To compile this driver as a module, choose M here: the
	  module will be called 88pm860x-ts	        
endif
```
