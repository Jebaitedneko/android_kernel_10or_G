/* Copyright (c) 2013, The Linux Foundation. All rights reserved.
 *
 * This program is free software; you can redistribute it and/or modify
 * it under the terms of the GNU General Public License version 2 and
 * only version 2 as published by the Free Software Foundation.
 *
 * This program is distributed in the hope that it will be useful,
 * but WITHOUT ANY WARRANTY; without even the implied warranty of
 * MERCHANTABILITY or FITNESS FOR A PARTICULAR PURPOSE.  See the
 * GNU General Public License for more details.
 */

/*---------------------------------------------------------------------------
 * This file is autogenerated file using gcdb parser. Please do not edit it.
 * Update input XML file to add a new entry or update variable in this file
 * VERSION = "1.0"
 *---------------------------------------------------------------------------*/
&mdss_mdp {
	dsi_kd_otm1289a_720p_video: qcom,mdss_dsi_kd_otm1289a_720p_video {
		qcom,mdss-dsi-panel-name = "kd_otm1289a 720p video mode dsi panel";
		qcom,mdss-dsi-panel-controller = <&mdss_dsi0>;
		qcom,mdss-dsi-panel-type = "dsi_video_mode";
		qcom,mdss-dsi-panel-destination = "display_1";
		qcom,mdss-dsi-panel-framerate = <60>;
		qcom,mdss-dsi-virtual-channel-id = <0>;
		qcom,mdss-dsi-stream = <0>;
		qcom,mdss-dsi-panel-width = <720>;
		qcom,mdss-dsi-panel-height = <1280>;
		qcom,mdss-dsi-h-front-porch = <86>;
		qcom,mdss-dsi-h-back-porch = <80>;
		qcom,mdss-dsi-h-pulse-width = <20>;
		qcom,mdss-dsi-h-sync-skew = <0>;
		qcom,mdss-dsi-v-back-porch = <22>;
		qcom,mdss-dsi-v-front-porch = <12>;
		qcom,mdss-dsi-v-pulse-width = <8>;
		qcom,mdss-dsi-h-left-border = <0>;
		qcom,mdss-dsi-h-right-border = <0>;
		qcom,mdss-dsi-v-top-border = <0>;
		qcom,mdss-dsi-v-bottom-border = <0>;
		qcom,mdss-dsi-bpp = <24>;
		qcom,mdss-dsi-color-order = "rgb_swap_rgb";
		qcom,mdss-dsi-underflow-color = <0xff>;
		qcom,mdss-dsi-border-color = <0>;
		qcom,mdss-pan-physical-width-dimension = <65>;
		qcom,mdss-pan-physical-height-dimension = <116>;
		qcom,mdss-dsi-on-command = [29 01 00 00 00 00 02 00 00
				29 01 00 00 00 00 04 ff 12 89 01
				29 01 00 00 00 00 02 00 80
				29 01 00 00 00 00 03 ff 12 89
				29 01 00 00 00 00 02 00 81
				29 01 00 00 00 00 02 C4 28
				29 01 00 00 00 00 02 00 85
				29 01 00 00 00 00 02 C4 60
				29 01 00 00 00 00 02 00 A2
				29 01 00 00 00 00 02 f5 60
				29 01 00 00 00 00 02 00 B0
				29 01 00 00 00 00 02 CA 04
				29 01 00 00 00 00 02 00 90
				29 01 00 00 00 00 04 C5 44 44 3a
				29 01 00 00 00 00 02 00 90
				29 01 00 00 00 00 02 ff b0
				29 01 00 00 00 00 02 00 80
				29 01 00 00 00 00 09 c0 4a 00 10 10 96 01 68 40
				29 01 00 00 00 00 02 00 90
				29 01 00 00 00 00 04 c0 3b 01 09
				29 01 00 00 00 00 02 00 8c
				29 01 00 00 00 00 02 c0 00
				29 01 00 00 00 00 02 00 80
				29 01 00 00 00 00 02 c1 33
				29 01 00 00 00 00 02 00 85
				29 01 00 00 00 00 04 c5 0a 0a a9
				29 01 00 00 00 00 02 00 00
				29 01 00 00 00 00 03 d8 27 27
				29 01 00 00 00 00 02 00 84
				29 01 00 00 00 00 02 C4 02
				29 01 00 00 00 00 02 00 93
				29 01 00 00 00 00 02 C4 04
				29 01 00 00 00 00 02 00 96
				29 01 00 00 00 00 02 F5 E7
				29 01 00 00 00 00 02 00 A0
				29 01 00 00 00 00 02 F5 4A
				29 01 00 00 00 00 02 00 8a
				29 01 00 00 00 00 02 c0 11
				29 01 00 00 00 00 02 00 83
				29 01 00 00 00 00 02 F5 81
				29 01 00 00 00 00 02 00 90
				29 01 00 00 00 00 03 c4 96 05
				29 01 00 00 00 00 02 00 80
				29 01 00 00 00 00 10 cb 14 14 14 14 14 14 14 14 14 00 14 14 00 00 14
				29 01 00 00 00 00 02 00 90
				29 01 00 00 00 00 08 cb 14 00 00 00 00 00 00
				29 01 00 00 00 00 02 00 80
				29 01 00 00 00 00 0F cc 06 1d 1e 1d 1d 10 0c 0e 0a 00 02 00 00 00
				29 01 00 00 00 00 02 00 90
				29 01 00 00 00 00 10 cc 02 00 00 00 00 00 00 05 1d 1e 1d 1d 0f 0b 0d
				29 01 00 00 00 00 02 00 a0
				29 01 00 00 00 00 0E cc 09 00 01 00 00 00 01 00 00 00 00 00 00
				29 01 00 00 00 00 02 00 b0
				29 01 00 00 00 00 0F cc 01 1e 1d 1d 1d 09 0d 0b 0f 00 05 00 00 00
				29 01 00 00 00 00 02 00 c0
				29 01 00 00 00 00 10 cc 05 00 00 00 00 00 00 02 1e 1d 1d 1d 0a 0e 0c
				29 01 00 00 00 00 02 00 d0
				29 01 00 00 00 00 0E cc 10 00 06 00 00 00 06 00 00 00 00 00 00
				29 01 00 00 00 00 02 00 80
				29 01 00 00 00 00 07 ce 87 05 10 86 00 00
				29 01 00 00 00 00 02 00 90
				29 01 00 00 00 00 0A ce 34 ff 10 05 00 00 00 00 00
				29 01 00 00 00 00 02 00 a0
				29 01 00 00 00 00 10 ce 30 83 86 87 16 00 82 85 87 81 84 87 80 83 87
				29 01 00 00 00 00 02 00 b0
				29 01 00 00 00 00 10 ce 30 00 82 87 16 00 01 81 87 02 80 87 03 00 87
				29 01 00 00 00 00 02 00 F0
				29 01 00 00 00 00 07 CE 01 20 C1 81 00 00
				29 01 00 00 00 00 02 00 00
				29 01 00 00 00 00 11 E1 1a 33 40 54 62 7d 7a 90 66 54 5c 42 29 0b 07 00
				29 01 00 00 00 00 02 00 00
				29 01 00 00 00 00 11 E2 1a 33 40 54 62 7d 7a 90 66 54 5c 42 29 0b 07 00
				29 01 00 00 00 00 02 00 00
				29 01 00 00 00 00 04 ff ff ff ff
				29 01 00 00 00 00 02 51 00
				29 01 00 00 00 00 02 53 24
				05 01 00 00 78 00 02 11 00
				05 01 00 00 0a 00 02 29 00
			];
		qcom,mdss-dsi-off-command = [05 01 00 00 32 00 02 28 00
					05 01 00 00 78 00 02 10 00];
		qcom,mdss-dsi-on-command-state = "dsi_lp_mode";
		qcom,mdss-dsi-off-command-state = "dsi_hs_mode";
		qcom,mdss-dsi-h-sync-pulse = <1>;
		qcom,panel-supply-entries = <&dsi_panel_pwr_supply>;
		qcom,mdss-dsi-traffic-mode = "burst_mode";
		qcom,mdss-dsi-lane-map = "lane_map_0123";
		qcom,mdss-dsi-bllp-eof-power-mode;
		qcom,mdss-dsi-bllp-power-mode;
		qcom,mdss-dsi-lane-0-state;
		qcom,mdss-dsi-lane-1-state;
		qcom,mdss-dsi-lane-2-state;
		qcom,mdss-dsi-lane-3-state;
		qcom,mdss-dsi-panel-timings = [7a 1a 12 00 40 42 16 1e 14 03 04 00];
		qcom,mdss-dsi-t-clk-post = <0x04>;
		qcom,mdss-dsi-t-clk-pre = <0x1a>;
		qcom,mdss-dsi-panel-clockrate = <431180000>;
		qcom,mdss-dsi-bl-min-level = <2>;
		qcom,mdss-dsi-bl-max-level = <255>;
		qcom,mdss-dsi-dma-trigger = "trigger_sw";
		qcom,mdss-dsi-mdp-trigger = "none";
		qcom,mdss-dsi-bl-pmic-control-type = "bl_ctrl_dcs";
		qcom,mdss-dsi-reset-sequence = <1 5>, <0 10>, <1 5>;
		qcom,mdss-dsi-lp11-init;
		qcom,mdss-dsi-tx-eot-append;
		qcom,mdss-dsi-force-clock-lane-hs;
		qcom,mdss-dsi-panel-status-command = [
			06 01 00 01 05 00 01 0a];
		qcom,mdss-dsi-panel-status-command-state = "dsi_lp_mode";
		qcom,mdss-dsi-panel-status-check-mode = "reg_read";
		qcom,mdss-dsi-panel-status-read-length = <1>;
		qcom,mdss-dsi-panel-status-value = <0x9c>;
		qcom,esd-check-enabled;
	};
};
